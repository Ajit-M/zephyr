## samples/uart_comm_Back_up/sample.yaml
```yaml
sample:
  description: Simple UART communication with buffer for Receiver SBUS application
  name: UART Communication
common:
    tags: introduction
    integration_platforms:
      - native_posix
    harness: console
    harness_config:
      type: one_line
      regex:
        - "Hello World! (.*)"
tests:
  sample.basic.helloworld:
    tags: introduction
```
