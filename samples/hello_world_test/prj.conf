## CMakeLists.txt
```
# SPDX-License-Identifier: Apache-2.0

cmake_minimum_required(VERSION 3.13.1)

find_package(Zephyr REQUIRED HINTS $ENV{ZEPHYR_BASE})
project(hello_world_test)

target_sources(app PRIVATE src/main.c)
```

## prj.conf
```kconfig
CONFIG_STDOUT_CONSOLE=y
CONFIG_PRINTK=y
CONFIG_PWM=y
CONFIG_LOG=y
CONFIG_LOG_PRINTK=y
CONFIG_LOG_IMMEDIATE=y
CONFIG_PWM_LOG_LEVEL_DBG=y
CONFIG_SERIAL=y
CONFIG_I2C=y
CONFIG_SENSOR=y
CONFIG_MPU6050=y
CONFIG_MPU6050_TRIGGER_NONE=y
CONFIG_CBPRINTF_FP_SUPPORT=y
CONFIG_HW_STACK_PROTECTION=y
```

## src/main.c
```c
/*
 * Copyright (c) 2012-2014 Wind River Systems, Inc.
 *
 * SPDX-License-Identifier: Apache-2.0
 */

#include <zephyr.h>
#include <device.h>
#include <drivers/gpio.h>
#include <sys/printk.h>
#include <drivers/pwm.h>
#include <drivers/uart.h>
#include <kernel.h>

#define DT_ALIAS_PWM_0_LABEL "PWM_2"
#define PWM_LED0_NODE "PWM_4"
#define MY_UART_RC "UART_1"
#define MY_UART_MON "UART_2"


#ifndef DT_ALIAS_PWM_0_LABEL
#error "PWM device label not defined"
#endif

#ifndef PWM_LED0_NODE
#error "PWM device label not defined"
#endif


#define SBUS_FAILSAFE_INACTIVE 0
#define SBUS_FAILSAFE_ACTIVE   1
#define SBUS_STARTBYTE         0x0f
#define SBUS_ENDBYTE           0x00


/* period of servo motor signal ->  20ms (50Hz) */
#define PERIOD (USEC_PER_SEC / 50U)

// #define IMU_1 (const char *const) MPU6050



void main(void)
{
	
	printk("Hello Samyak! %s\n", CONFIG_BOARD);


	const struct device *i2c_dev;	
	// const char *const label = DT_LABEL(DT_INST(0, invensense_mpu6050));
	// const struct device *mpu6050 = device_get_binding(label);
	
	const char *const IMU_1 = "MPU6050";
	// i2c_dev = device_get_binding(label);
	

	// printk(DT_LABEL(DT_INST(0, invensense_mpu6050)));
	
	i2c_dev = device_get_binding(IMU_1);

	if (!i2c_dev){
		printk("Cannot find UART1 device!\n");
		return;
	}
	else
	{
		printk("UARt1  device is found \n");
	}




}
```

## src/rc_input.h
```c
// Helper function to read and write uart data from Frsky 

#include <device.h>

void rc_input(deveice *uartrc_dev);

/*
* Hardware Serial Supported:
*  STM32F4 
*/


class SBUS{
	public:
		SBUS(HardwareSerial& bus);
		void begin();
		bool read(uint16_t* channels, bool* failsafe, bool* lostFrame);
		bool readCal(float* calChannels, bool* failsafe, bool* lostFrame);
		// void write(uint16_t* channels);
		// void writeCal(float *channels);
		// void setEndPoints(uint8_t channel,uint16_t min,uint16_t max);
		// void getEndPoints(uint8_t channel,uint16_t *min,uint16_t *max);
		// void setReadCal(uint8_t channel,float *coeff,uint8_t len);
		// void getReadCal(uint8_t channel,float *coeff,uint8_t len);
		// void setWriteCal(uint8_t channel,float *coeff,uint8_t len);
		// void getWriteCal(uint8_t channel,float *coeff,uint8_t len);
		~SBUS();
  private:
		const uint32_t _sbusBaud = 100000;
		static const uint8_t _numChannels = 16;
		const uint8_t _sbusHeader = 0x0F;
		const uint8_t _sbusFooter = 0x00;
		const uint8_t _sbus2Footer = 0x04;
		const uint8_t _sbus2Mask = 0x0F;
		const uint32_t SBUS_TIMEOUT_US = 7000;
		uint8_t _parserState, _prevByte = _sbusFooter, _curByte;
		static const uint8_t _payloadSize = 24;
		uint8_t _payload[_payloadSize];
		const uint8_t _sbusLostFrame = 0x04;
		const uint8_t _sbusFailSafe = 0x08;
		const uint16_t _defaultMin = 172;
		const uint16_t _defaultMax = 1811;
		uint16_t _sbusMin[_numChannels];
		uint16_t _sbusMax[_numChannels];
		float _sbusScale[_numChannels];
		float _sbusBias[_numChannels];
		float **_readCoeff, **_writeCoeff;
		uint8_t _readLen[_numChannels],_writeLen[_numChannels];
		bool _useReadCoeff[_numChannels], _useWriteCoeff[_numChannels];
		HardwareSerial* _bus;
		bool parse();
		void scaleBias(uint8_t channel);
		float PolyVal(size_t PolySize, float *Coefficients, float X);
};

#endif
```
